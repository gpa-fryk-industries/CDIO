/dts-v1/;

/{
    /* Enable serial terminal (NOTE: conflicts with SWD so cannot debug simultaneously!) */
    //enable-serial;

    /* Enable FPGA power and configuration */
    enable-fpga;

    /* Enable MCO clock output  */
    enable-mco;

    /* Enable Radio */
    //enable-radio;

    /* Load configuration data into FPGA */
    config-fpga;

};